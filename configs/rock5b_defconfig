## configs/rock5b_defconfig
```kconfig
BR2_ARM64_CPU_ARMV8A=y
BR2_ARM64_ENABLE_NEON=y
BR2_ARM64_ENABLE_CRC=y
BR2_GLOBAL_PATCH_DIR="$(BR2_EXTERNAL_HASSOS_PATH)/board/radxa/rock5b/patches"
BR2_LINUX_KERNEL=y
BR2_LINUX_KERNEL_CUSTOM_GIT=y
BR2_LINUX_KERNEL_CUSTOM_REPO_URL="https://github.com/armbian/linux-rockchip"
BR2_LINUX_KERNEL_CUSTOM_REPO_VERSION="rk-6.1-rkr5.1"
BR2_LINUX_KERNEL_DEFCONFIG="rockchip_linux"
BR2_LINUX_KERNEL_CONFIG_FRAGMENT_FILES="$(BR2_EXTERNAL_HASSOS_PATH)/board/radxa/rock5b/kernel.config"
BR2_LINUX_KERNEL_NEEDS_HOST_LIBELF=y
BR2_PACKAGE_LINUX_TOOLS_PERF=y
BR2_PACKAGE_HOST_LINUX_TOOLS=y

# NPU/GPU support
BR2_PACKAGE_RKNPU=y
BR2_PACKAGE_RKNPU_FIRMWARE=y
BR2_PACKAGE_MALI_G610=y
BR2_PACKAGE_LIBDRM=y
BR2_PACKAGE_LIBDRM_ROCKCHIP=y
BR2_PACKAGE_MESA3D=y
BR2_PACKAGE_MESA3D_DRIVER_PANFROST=y

# Fan control tools
BR2_PACKAGE_LM_SENSORS=y
BR2_PACKAGE_LM_SENSORS_SENSORS=y
BR2_PACKAGE_ROCKCHIP_FAN_CTRL=y

BR2_PACKAGE_UBOOT=y
BR2_PACKAGE_UBOOT_BOARD_DEFCONFIG="rock5b"
BR2_TARGET_UBOOT_NEEDS_DTC=y
BR2_TARGET_UBOOT_FORMAT_IMG=y
BR2_TARGET_UBOOT_SPL=y
BR2_TARGET_UBOOT_SPL_NAME="idbloader.img"
BR2_TARGET_UBOOT_CUSTOM_ENV=y
BR2_TARGET_UBOOT_CUSTOM_ENV_PATH="$(BR2_EXTERNAL_HASSOS_PATH)/board/radxa/rock5b/boot-env.txt"
```
